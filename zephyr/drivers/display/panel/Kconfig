## zephyr/drivers/display/panel/Kconfig
```kconfig
# Configuration options for Actions Display Panel

# Copyright (c) 2020 Actions Technology Co., Ltd
# SPDX-License-Identifier: Apache-2.0

if DISPLAY_LCDC

rsource "Kconfig.panel_gc9c01"
rsource "Kconfig.panel_jd9854"
rsource "Kconfig.panel_rm69090"
rsource "Kconfig.panel_st7789v2"
rsource "Kconfig.panel_gc9307"
endif # DISPLAY_LCDC
```

## zephyr/drivers/display/panel/Kconfig.panel_gc9307
```kconfig
# RM69090 display driver configuration options

# Copyright (c) 2019 Marc Reilly <marc@cpdesign.com.au>
# SPDX-License-Identifier: Apache-2.0

menuconfig PANEL_GC9307
	bool "GC9307 display driver"
	help
	  Enable driver for GC9307 display driver.

if PANEL_GC9307

config PANEL_LARK_GC9307
	bool "Display LCD panel on SoC Lark"
	default y
	depends on (SOC_SERIES_LARK || SOC_SERIES_LARK_FPGA)
	help
	  Enable LCD display controller on SoC Lark
endif # PANEL_GC9307
```

## zephyr/drivers/display/panel/Kconfig.panel_gc9c01
```kconfig
# GC9C01 display driver configuration options

# Copyright (c) 2019 Marc Reilly <marc@cpdesign.com.au>
# SPDX-License-Identifier: Apache-2.0

menuconfig PANEL_GC9C01
	bool "GC9C01 display driver"
	help
	  Enable driver for GC9C01 display driver.

if PANEL_GC9C01

endif # PANEL_GC9C01
```

## zephyr/drivers/display/panel/Kconfig.panel_jd9854
```kconfig
# JD9854 display driver configuration options

# Copyright (c) 2019 Marc Reilly <marc@cpdesign.com.au>
# SPDX-License-Identifier: Apache-2.0

menuconfig PANEL_JD9854
	bool "Display jd9854"
	help
	  Enable JD9854 panel display.
```

## zephyr/drivers/display/panel/Kconfig.panel_rm69090
```kconfig
# RM69090 display driver configuration options

# Copyright (c) 2019 Marc Reilly <marc@cpdesign.com.au>
# SPDX-License-Identifier: Apache-2.0

menuconfig PANEL_RM69090
	bool "RM69090 display driver"
	help
	  Enable driver for RM69090 display driver.

if PANEL_RM69090

endif # PANEL_RM69090
```

## zephyr/drivers/display/panel/Kconfig.panel_st7789v2
```kconfig
# RM69090 display driver configuration options

# Copyright (c) 2019 Marc Reilly <marc@cpdesign.com.au>
# SPDX-License-Identifier: Apache-2.0

menuconfig PANEL_ST7789V2
	bool "ST7789V2 display driver"
	help
	  Enable driver for ST7789V2 display driver.

if PANEL_ST7789V2

endif # PANEL_ST7789V2
```

## zephyr/drivers/flash/Kconfig.acts
```kconfig
# Copyright (c) 2018 Intel Corporation
# SPDX-License-Identifier: Apache-2.0


menuconfig SPI_FLASH_ACTS
	bool "actions SPI flash driver"
	select FLASH_HAS_DRIVER_ENABLED
	select FLASH_HAS_PAGE_LAYOUT
	help
	  Enable support for actions SPI flash driver

config SPI_NOR_FLASH_4B_ADDRESS
	bool
	prompt "Support NOR flash 4-byte address driver"
	default n
	depends on SPI_FLASH_ACTS
	help
		If you say Y here, you will get support NOR flash 4-byte address driver.
		If unsure, it is safe to say N.
```

## zephyr/drivers/fm/AR1019/Kconfig
```kconfig
# Kconfig - FM DRV configuration options

#
# Copyright (c) 2015 Intel Corporation
#
# SPDX-License-Identifier: Apache-2.0
#

#
# FM DRV options
#

config FM_AR1019
	bool "fm AR1019 module support"
	depends on FM
	default n
	help
	  enable actions fm AR1019
```

## zephyr/drivers/fm/Kconfig
```kconfig
# Kconfig - FM DRV configuration options

#
# Copyright (c) 2015 Intel Corporation
#
# SPDX-License-Identifier: Apache-2.0
#

#
# FM DRV options
#
config FM
	bool "actions fm module support"
	depends on I2C
	default n
	help
	  enanle actions fm module
	  
config FM_AR1019
	bool "fm AR1019 module support"
	depends on FM
	default n
	help
	  enable actions fm AR1019
	  
	  
config FM_RDA5807
	bool "fm RDA5807 module support"
	depends on FM
	default n
	help
	  enable actions fm RDA5807
```

## zephyr/drivers/fm/rda5807/Kconfig
```kconfig
# Kconfig - FM DRV configuration options

#
# Copyright (c) 2015 Intel Corporation
#
# SPDX-License-Identifier: Apache-2.0
#

#
# FM DRV options
#

config FM_RDA5807
	bool "fm RDA5807 module support"
	depends on FM
	default n
	help
	  enable actions fm RDA5807
```

## zephyr/drivers/input/ear_inout/Kconfig
```kconfig
# Configuration options for Actions INPUT YP DRIVERS

# Copyright (c) 2020 Actions Technology Co., Ltd
# SPDX-License-Identifier: Apache-2.0

if INPUT_DEV_EAR_INOUT

config INPUT_DEV_EAR_JSA1227
  bool "earphone in out driver"
	default n
	help
	  Enable support for ear inout driver.

endif # INPUT_DEV_EAR_INOUT
```

## zephyr/drivers/mmc/Kconfig.acts
```kconfig
# Copyright (c) 2018 Intel Corporation
# SPDX-License-Identifier: Apache-2.0


if MMC

config MMC_SDCARD
	bool "Support SD Card"
	default n
	help
	  Enable support for SD Card.

config MMC_SDIO
	bool "SDIO driver"
	default n
	help
	  Enable support for SDIO.

config MMC_ACTS
	bool "Actions SoC MMC driver"
	default n
	help
	  Enable MMC Controller of Actions SoC

endif
```

## zephyr/drivers/mt/CM001X1/Kconfig
```kconfig
# Kconfig - MT DRV configuration options

#
# Copyright (c) 2015 Intel Corporation
#
# SPDX-License-Identifier: Apache-2.0
#

#
# MT DRV options
#

config MAGIC_TUNE_CM001X1
    bool "CM001X1 module support"
    depends on MAGIC_TUNE
    default n
    help
      enable actions tune module CM001X1
```

## zephyr/drivers/mt/Kconfig
```kconfig
# Kconfig - MT DRV configuration options

#
# Copyright (c) 2015 Intel Corporation
#
# SPDX-License-Identifier: Apache-2.0
#

#
# Magic Tune Module DRV options
#
config MAGIC_TUNE
    bool "actions tune module support"
    depends on I2C
    default n
    help
      enanle actions tune module
      
config MAGIC_TUNE_CM001X1
    bool "CM001X1 tune module support"
    depends on MAGIC_TUNE
    default n
    help
      enable actions tune module CM001X1
      
```

## zephyr/drivers/pa/ACM8625/Kconfig
```kconfig
# Kconfig - PA DRV configuration options

#
# Copyright (c) 2015 Intel Corporation
#
# SPDX-License-Identifier: Apache-2.0
#

#
# PA DRV options
#

config PA_ACM8625
    bool "pa acm8625  module support"
    depends on PA
    default n
    help
      enable actions pa ACM8625
```

## zephyr/drivers/pa/Kconfig
```kconfig
# Kconfig - FM DRV configuration options

#
# Copyright (c) 2015 Intel Corporation
#
# SPDX-License-Identifier: Apache-2.0
#

#
# PA DRV options
#
config PA
    bool "actions pa module support"
    depends on I2C
    default n
    help
      enanle actions pa module
      
config PA_ACM8625
    bool "pa ACM8625 module support"
    depends on PA
    default n
    help
      enable actions pa ACM8625
      
```

## zephyr/drivers/power_supply/Kconfig
```kconfig
# Kconfig - Power supply configuration options
#
#
# Copyright (c) 2021 Actions Semiconductor Co., Ltd
#
# SPDX-License-Identifier: Apache-2.0
#

menuconfig POWER_SUPPLY
    bool
    prompt "Power supply drivers"
    default n
    help
      Enable power supply drivers configuration

if POWER_SUPPLY

config POWER_SUPPLY_ACTS_BATTERY
    bool "Actions SoC battery power supply driver"
    depends on SOC_FAMILY_ACTS
    default n
    help
      Enable support for Actions SoC battery driver.

choice
    prompt "Actsion Soc battery power supply methods"
    default ACTS_BATTERY_SUPPLY_INTERNAL
    depends on POWER_SUPPLY_ACTS_BATTERY
    help
        This option will select the different methods for the battery power supply.

config ACTS_BATTERY_SUPPLY_INTERNAL
    bool "battery supplied by internal charger"
    help
        Support battery power supplied by internal charger.

config ACTS_BATTERY_SUPPLY_EXTERNAL
    bool "battery supplied by external charger"
    help
        Support battery power supplied by external charger.
		
config ACTS_BATTERY_ONLY_BATTERY_SAMPLE
    bool "battery supplied by only sample"
    help
        Support battery only sample function.		

endchoice

config ACTS_BATTERY_SUPPLY_CHARGER_BOX
    bool "battery supplied by the charger box"
    depends on ACTS_BATTERY_SUPPLY_INTERNAL
    help
        Support battery power supplied by charger box.

config ACTS_BATTERY_SUPPLY_EXT_COULOMETER
    bool "battery measure by external coulometer"
    depends on ACTS_BATTERY_SUPPLY_EXTERNAL
    help
        Support bettery power measured by external coulometer.

config ACTS_BATTERY_SUPPORT_CHARGER_NTC
    bool "battery support NTC temperature detect"
    depends on ACTS_BATTERY_SUPPLY_INTERNAL
	default n
    help
        Support battery temperature detect.

config ACTS_BATTERY_SUPPORT_FAST_CHARGER
    bool "battery support fast charge function"
    depends on ACTS_BATTERY_SUPPLY_INTERNAL
	default n
    help
        Support battery fast charge.
		
config ACTS_BATTERY_POWERON_MIN_VOL_WITHOUT_DC5V
    int "power on min voltage setting"
	default 3300
    help
        Set power on min voltage when not plug dc5v .		

endif # POWER_SUPPLY
```

## zephyr/drivers/test/Kconfig
```kconfig
# drivers configuration options

# Copyright (c) 2015 Intel Corporation
# SPDX-License-Identifier: Apache-2.0

source "drivers/test/i2c/Kconfig"
source "drivers/test/spi/Kconfig"
```

## zephyr/drivers/test/i2c/Kconfig
```kconfig
# drivers configuration options

# Copyright (c) 2015 Intel Corporation
# SPDX-License-Identifier: Apache-2.0

config TEST_I2C_MASTER
	bool "Enable Asynchronous call support"
	default n
	help
	  This option enable i2c master test.

config TEST_I2C_SLAVE
	bool "Enable Asynchronous call support"
	default n
	help
	  This option enable i2c slave test.
```

## zephyr/drivers/test/spi/Kconfig
```kconfig
# drivers configuration options

# Copyright (c) 2015 Intel Corporation
# SPDX-License-Identifier: Apache-2.0

config TEST_SPI_MASTER
	bool "Enable Asynchronous call support"
	default n
	help
	  This option enable spi master test.

config TEST_SPI_SLAVE
	bool "Enable Asynchronous call support"
	default n
	help
	  This option enable spi slave test.
```

## zephyr/framework/sensor/sensor_algo/Kconfig
```kconfig
# Configuration options for Actions Sensor

# Copyright (c) 2020 Actions Technology Co., Ltd
# SPDX-License-Identifier: Apache-2.0

menuconfig SENSOR_ALGO
	bool "Sensor algorithm"
	help
	  Enable Sensor algorithm

if SENSOR_ALGO

config HR_ROM_BASE
	hex
	default 0x10001000 if SOC_LARK
	help
	  Sensor rom base address for sensor algorithm

config SENSOR_ROM_BASE
	hex
	default 0x10020000 if SOC_LARK
	help
	  Sensor rom base address for sensor algorithm

config SENSOR_SLEEP_ROM_BASE
	hex
	default 0x1003a000 if SOC_LARK
	help
	  Sensor rom base address for sensor algorithm

endif # SENSOR_ALGO
```

## zephyr/lib/gui/lvgl/Kconfig
```kconfig
# Copyright (c) 2018-2019 Jan Van Winkel <jan.van_winkel@dxplore.eu>
# Copyright (c) 2020 Teslabs Engineering S.L.
# SPDX-License-Identifier: Apache-2.0

menuconfig LVGL
	bool "LittlevGL GUI library"
	help
	  This option enables the LittlevGL GUI library.

if LVGL

config APP_LINK_WITH_LVGL
	bool "Link 'app' with LVGL"
	default y
	help
	  Add LVGL header files to the 'app' include path. It may be
	  disabled if the include paths for LVGL are causing aliasing
	  issues for 'app'.

config LVGL_VDB_SIZE
	int "Rendering buffer size in pixels"
	default 0
	help
	  Size of the buffer used for rendering screen content in pixels.

config LVGL_DOUBLE_VDB
	bool "Use two rendering buffers"
	help
	  Use two buffers to render and flush data in parallel

config LVGL_USE_FILESYSTEM
	bool "File system"
	help
	  Enable filesystem support.

rsource "Kconfig.lvgl"

endif # LVGL
```

## zephyr/soc/arm/actions/cuckoo/Kconfig.soc
```kconfig
# Copyright (c) 2016 Linaro Limited.
# SPDX-License-Identifier: Apache-2.0

choice
	prompt "CUCKOO MCU Selection"
	depends on SOC_SERIES_CUCKOO

config SOC_CUCKOO
	bool "CUCKOO"

endchoice

if SOC_CUCKOO

config SOC_SPI0_USE_CK64M
	bool
	prompt "enable cpu spi0 to use CK64M clock source"
	default y
	help
		enable cpu spi0 to use CK64M clock source

config IRQ_VECTOR_IN_SRAM
	bool
	prompt "enable irq vector copy to sram"
	default n
	help
		enable irq vector copy to sram

config SOC_EP_MODE
	bool
	prompt "indicate ep mode"
	default n
	help
		prompt "indicate ep mode
		
config SOC_CPU_USE_CK64M
	bool
	prompt "enable cpu to use CK64M clock source"
	default y
	help
		enable cpu to use CK64M clock source		
		
config SOC_CPU_USE_CK128M
	bool
	prompt "enable cpu to use CK64M clock source"
	default n
	help
		enable cpu to use CK128M clock source		

config SOC_DSP_FIX_USE_COREPLL
	bool
	prompt "enable dsp to fix use Corepll clock source"
	default y
	help
		enable dsp to fix use Corepll clock source				

config SOC_USE_SYS_ROM_CODE
	bool
	prompt "use system rom code"
	default n
	help
		enable use of system rom code

config SOC_USE_RINGBUF_ROM_CODE
	bool
	prompt "use ringbuf rom code"
	default n
	help
		enable use of ringbuf rom code

endif
```

## zephyr/subsys/fw_version/Kconfig
```kconfig
# Kconfig - Firmware version options
#
# Copyright (c) 2019 Actions Semiconductor Co.,Ltd
#
# SPDX-License-Identifier: Apache-2.0
#

menu "Firmware version"

config FIRMWARE_VERSION
	bool
	prompt "Enable firmware version interface"
	default y
	help
	  This option enable firmware version interface

config FW_VERSION_NUMBER
	hex
	prompt "Firmware Version Number"
	default 0x0000
	help
	  firmware version number in bcd format

endmenu
```
