## framework/display/Kconfig
```kconfig
# Kconfig - Actions system manager

#
# Copyright (c) 2016 Actions Corporation
#
# SPDX-License-Identifier: Apache-2.0
#

if ACTIONS_FRAMEWORK

menuconfig DISPLAY
	bool "Display Support"
	imply UI_MANAGER
	help
	  This option enables actions system manager.

config LED_MANAGER
	bool "LED Manager Support"
#	depends on LED
	help
	  This option enables actions led manager.

config SEG_LED_MANAGER
	bool "SEG LED Manager Support"
	depends on SEG_LED
	help
	  This option enables actions seg led  manager.

config UI_MANAGER
	bool "Ui Manager Support"
	help
	  This option enables actions app manager.

config UI_SERVICE
	bool "UI Service"
	depends on UI_MANAGER
	select DISPLAY_COMPOSER
	help
	  This option enables actions UI service.

if UI_SERVICE

config UISRV_PRIORITY
	int "UI Service Thread Priority"
	default 1
	help
	  This option set ui service thread priority

config UISRV_STACKSIZE
	int "UI Service Thread Stack Size"
	default 2536
	help
	  This option set stack size for ui service thread

config UISRV_VIEW_PAUSED_SNAPSHOT
	bool "UI View Snapshot when Paused"
	help
	  This option take snapshot of view surface buffer when view paused,
	  When enabled, the surface buffer can be restored quickly when resumed.

config UISRV_KEY_EVENT_BYPASS
	bool "UI Input Key Event Bypass View"
	default y
	help
	  This option enables UI input key event bypass view, and sent directly
	  to foreground application, which may impove the view switching speed.

config UI_INPUT_RECORDER
	bool "UI Input TP Event Recorder"
	help
	  This option enables UI input TP event recorder.

config UI_CUSTOM_GESTURE_DETECTION
	bool "UI Software Gesture Detection"
	help
	  This option enable software gesture detection, which will override the
	  tpkey hardware gesture value if exists.

config VIEW_CACHE_LEVEL
	int "cache level for view cache"
	default 1
	help
	  This option set cache level for view cache

config VIEW_STACK_LEVEL
	int "maximum number of elements in view stack"
	default 5
	help
	  This option set maximum number of elements in view stack

config NUM_MSGBOX_POPUPS
	int "Maximum number of in-flight msgbox popups"
	default 3
	help
	  Set maximum number of in-flight msgbox popups.

endif # UI_SERVICE

choice
	prompt "Surface Buffer Swap Mode"
	default SURFACE_DOUBLE_BUFFER
	depends on UI_SERVICE

config SURFACE_DOUBLE_BUFFER
	bool "Double Buffer"

config SURFACE_SINGLE_BUFFER
	bool "Single Buffer"

config SURFACE_ZERO_BUFFER
	bool "Buffer Less"

endchoice

config SURFACE_MAX_BUFFER_COUNT
	int
	range 0 2
	default 0 if SURFACE_ZERO_BUFFER
	default 1 if SURFACE_SINGLE_BUFFER
	default 2 if SURFACE_DOUBLE_BUFFER

config RES_MANAGER
	bool "res_manager library"
	help
	  This option enables the res_manager library.

config SIMPLE_RES_MANAGER
	bool "simple res_manager library"
	help
	  This option enables the simple res_manager library.

config RES_MEM_POOL_MAX_BLOCK_NUMBER
	int "max block number for res manager psram memory"
	default 2380
	help
	  This option set max block number for res manager psram memory allocation

config RES_MEM_POOL_SCENE_MAX_BLOCK_NUMBER
	int "max block number for res manager scene cache memory"
	default 96
	help
	  This option set max block number for res manager scene cache memory allocation

config RES_MANAGER_DISABLE_AUTO_SEARCH_FILES
	bool "disable auto search for updated res files"
	default n
	help
	  This option disables auto search for updated res files on incremental update

config RES_MANAGER_USE_SDFS
	bool "use sdfs instead of fatfs to read res files"
	default n
	help
	  This option make res manager to use sdfs to read res files	

orsource "Kconfig.font"	  
orsource "Kconfig.lvgl"
rsource "memory/Kconfig"

endif # ACTIONS_FRAMEWORK
```

## framework/display/Kconfig.font
```kconfig
# Kconfig - Actions font manager

#
# Copyright (c) 2016 Actions Corporation
#
# SPDX-License-Identifier: Apache-2.0
#

config BITMAP_FONT
	bool "bitmap font library"
	help
	  This option enables the bitmap font library.

if BITMAP_FONT

config BITMAP_FONT_USE_HIGH_FREQ_CACHE
	bool "bitmap font high freq cache"
	help
	  This option enables bitmap font high freqency cache.

config BITMAP_FONT_HIGH_FREQ_CACHE_SIZE
	int "high freq char cache size"
	default 1536000
	help
	   This option set max font cache size for high freq Hanzi chars

config BITMAP_PER_FONT_CACHE_SIZE
	int "cache size per font size"
	default 65536
	help
	   This option set cache size for each font size

config BITMAP_FONT_MAX_OPENED_FONT
	int "max fonts can be opened"
	default 2
	help
	  This option set max num of opened fonts

config BITMAP_FONT_SUPPORT_EMOJI
	bool "bitmap font emoji support"
	help
	  This option enables bitmap font emoji support.	  

endif # BITMAP_FONT

config FREETYPE_FONT
	bool "freetype font library"
	help
	  This option enables the freetype font library.

if FREETYPE_FONT

config FREETYPE_MEM_POOL_USER
	bool "freetype use mem pool"
	help
	  This option enables the freetype mem pool.

endif # FREETYPE_FONT
```

## framework/display/memory/Kconfig
```kconfig
# Kconfig - Actions memory manager

#
# Copyright (c) 2016 Actions Corporation
#
# SPDX-License-Identifier: Apache-2.0
#

menuconfig UI_MEMORY_MANAGER
	bool "ui memory manager"
	default y if UI_SERVICE
	help
	  This option enables ui memory manager

if UI_MEMORY_MANAGER

choice
	prompt "UI Memory Management"
	default UI_MEM_USE_POOL
	help
	  Memory Management for UI Surface Buffers

	config UI_MEM_USE_SLAB
		bool "Memory Slab"
		depends on MEMORY_SLABS
		help
		  Use memory slab to allocate UI surface buffer.

	config UI_MEM_USE_POOL
		bool "Memory Pool with Fixed-Size Blocks"
		help
		  Use fixed-size memory block to allocate UI surface buffer.

endchoice

if UI_MEM_USE_POOL

config UI_MEM_BLOCK_SIZE
	int "Block Size"
	default 259200
	help
	  Size of the block in bytes.

config UI_MEM_NUMBER_BLOCKS
	int "Number of Blocks"
	default 1
	help
	  Number of (fixed-size) blocks.

endif # UI_MEM_USE_POOL

if UI_MEM_USE_SLAB

config UI_SLAB_TOTAL_NUM
	int "total slabes num"
	default 11
	help
	  This option set total slabes num

config UI_SLAB0_BLOCK_SIZE
	int "UI_SLAB0 block size of per slabes"
	default 8
	help
	  This option set block size of UI_SLAB0

config UI_SLAB0_NUM_BLOCKS
	int "UI_SLAB0 num of blocks of per slabes"
	default 0
	help
	  This option set num of blocks of UI_SLAB0

config UI_SLAB1_BLOCK_SIZE
	int "UI_SLAB1 block size of per slabes"
	default 16
	help
	  This option set block size of UI_SLAB1

config UI_SLAB1_NUM_BLOCKS
	int "UI_SLAB1 num of blocks of per slabes"
	default 0
	help
	  This option set num of blocks of UI_SLAB1

config UI_SLAB2_BLOCK_SIZE
	int "UI_SLAB2 block size of per slabes"
	default 32
	help
	  This option set block size of UI_SLAB2

config UI_SLAB2_NUM_BLOCKS
	int "UI_SLAB2 num of blocks of per slabes"
	default 0
	help
	  This option set num of blocks of UI_SLAB2

config UI_SLAB3_BLOCK_SIZE
	int "UI_SLAB3 block size of per slabes"
	default 64
	help
	  This option set block size of UI_SLAB3

config UI_SLAB3_NUM_BLOCKS
	int "UI_SLAB3 num of blocks of per slabes"
	default 0
	help
	  This option set num of blocks of UI_SLAB3

config UI_SLAB4_BLOCK_SIZE
	int "UI_SLAB4 block size of per slabes"
	default 128
	help
	  This option set block size of UI_SLAB4

config UI_SLAB4_NUM_BLOCKS
	int "UI_SLAB4 num of blocks of per slabes"
	default 0
	help
	  This option set num of blocks of UI_SLAB4

config UI_SLAB5_BLOCK_SIZE
	int "UI_SLAB5 block size of per slabes"
	default 256
	help
	  This option set block size of UI_SLAB5

config UI_SLAB5_NUM_BLOCKS
	int "UI_SLAB5 num of blocks of per slabes"
	default 0
	help
	  This option set num of blocks of UI_SLAB5

config UI_SLAB6_BLOCK_SIZE
	int "UI_SLAB6 block size of per slabes"
	default 512
	help
	  This option set block size of UI_SLAB6

config UI_SLAB6_NUM_BLOCKS
	int "UI_SLAB6 num of blocks of per slabes"
	default 0
	help
	  This option set num of blocks of UI_SLAB6

config UI_SLAB7_BLOCK_SIZE
	int "UI_SLAB7 block size of per slabes"
	default 1024
	help
	  This option set block size of UI_SLAB7

config UI_SLAB7_NUM_BLOCKS
	int "UI_SLAB7 num of blocks of per slabes"
	default 0
	help
	  This option set num of blocks of UI_SLAB7

config UI_SLAB8_BLOCK_SIZE
	int "UI_SLAB8 block size of per slabes"
	default 1536
	help
	  This option set block size of UI_SLAB8

config UI_SLAB8_NUM_BLOCKS
	int "UI_SLAB8 num of blocks of per slabes"
	default 0
	help
	  This option set num of blocks of UI_SLAB8

config UI_SLAB9_BLOCK_SIZE
	int "UI_SLAB8 block size of per slabes"
	default 2048
	help
	  This option set block size of UI_SLAB9

config UI_SLAB9_NUM_BLOCKS
	int "UI_SLAB8 num of blocks of per slabes"
	default 0
	help
	  This option set num of blocks of UI_SLAB9

config UI_SLAB10_BLOCK_SIZE
	int "UI_SLAB8 block size of per slabes"
	default 2048
	help
	  This option set block size of UI_SLAB9

config UI_SLAB10_NUM_BLOCKS
	int "UI_SLAB8 num of blocks of per slabes"
	default 0
	help
	  This option set num of blocks of UI_SLAB10

endif # UI_MEM_USE_SLAB

endif # UI_MEMORY_MANAGER

rsource "Kconfig.GUI"
```

## framework/display/memory/Kconfig.GUI
```kconfig
# Kconfig - Actions memory manager

#
# Copyright (c) 2016 Actions Corporation
#
# SPDX-License-Identifier: Apache-2.0
#

config GUI_TEXT_IMG_CACHE_SIZE
	int "Size of text image cache for GUI."
	default 0
	help
	  Set the size of text image cache, which cache the text as alpha image,
	  and the cached images may be accelearted.
```

## framework/media/Kconfig
```kconfig
# Kconfig - Actions media player

#
# Copyright (c) 2016 Actions Corporation
#
# SPDX-License-Identifier: Apache-2.0
#

menuconfig MEDIA
	bool
	prompt "media"
	imply MEDIA_PLAYER
	default n
	help
	This option enables actions media

config MEDIA_LIB_NAME
	string "media lib name"
	default "media"
	help
	  The library name of the media lib compiled output.

config MEDIA_PLAYER
	bool
	prompt "media player Support"
	depends on MEDIA
	select MEDIA_SERVICE
	select STREAM
	select RINGBUFF_STREAM
	default n
	help
	This option enables actions media player

config MEDIA_SERVICE
	bool
	prompt "Media Service Support"
	select THREAD_TIMER
	select AUDIO_SYSTEM
	default n
	help
	This option enables actions Media service.

config MEDIASRV_PRIORITY
    int
    prompt "Media Service Thread Priority"
    default 4
    depends on MEDIA_SERVICE
    help
    This option set audio thread priority  

config MEDIASRV_STACKSIZE
    int
    prompt "Media Service Thread Stack Size"
    default 2048
    depends on MEDIA_SERVICE
    help
    This option set stack size for audio service thread	 


config MEDIA_EFFECT
	bool
	prompt "media effect Support"
	depends on MEDIA_PLAYER
	default n
	help
	This option enables actions media effect

config MEDIA_EFFECT_OUTMODE
	int
	prompt "media effect output mode Support"
	depends on MEDIA_PLAYER
	default 0
	help
	This option enables actions media output mode 

config MUSIC_EFFECT
	bool
	prompt "music effect Support"
	depends on MEDIA_PLAYER
	select MEDIA_EFFECT
	select MUSIC_DAE
	default n
	help
	This option enables actions music effect

config MUSIC_EFFECT_HW_ACCELERATION
	bool
	prompt "music effect hw Support"
	depends on MUSIC_EFFECT
	default y
	help
	This option enables actions music effect hw acceleration

config MUSIC_DRC_EFFECT
	bool
	prompt "music drc effect Support"
	depends on MUSIC_EFFECT
	select MEDIA_EFFECT
	default n
	help
	This option enables actions music drc effect

config VOICE_EFFECT
	bool
	prompt "voice effect Support"
	depends on MEDIA_EFFECT
	default n
	help
	This option enables actions voice effect

config VOICE_EFFECT_HW_ACCELERATION
	bool
	prompt "voice effect hw Support"
	depends on VOICE_EFFECT
	default y
	help
	This option enables actions voice effect hw acceleration

config AEC_TAIL_LENGTH
	int
	prompt "AEC tail length config"
	depends on VOICE_EFFECT
	default 48
	help
	This option set AEC tail length config

config MEDIA_ENCODER_MCU
	bool
	prompt "mcu encode Support"
	depends on MEDIA
	default y
	help
	This option enables mcu encode

config MEDIA_ENCODER_DSP
	bool
	prompt "dsp encode Support"
	depends on MEDIA
	default y
	help
	This option enables dsp encode

config MEDIA_DECODER_MCU
	bool
	prompt "mcu decode Support"
	depends on MEDIA
	default y
	help
	This option enables mcu decode

config MEDIA_DECODER_DSP
	bool
	prompt "dsp decode Support"
	depends on MEDIA
	default y
	help
	This option enables dsp decode

config MEDIA_DECODER_RESTRANSMIT_TWS
	bool
	prompt "restransmit tws decoder Support"
	depends on MEDIA
	default n
	help
	This option enables restransmit tws decoder

config MEDIA_DECODER_SNOOP_TWS
	bool
	prompt "snoop tws decoder Support"
	depends on MEDIA
	default n
	help
	This option enables snoop tws decoder

config MEDIA_BG_RECORDER
	bool
	prompt "background record Support"
	depends on MEDIA
	default n
	help
	This option enables background recorder

config PLAYBACK_STREAM_PARSER
	bool
	prompt "playback stream parser Support"
	depends on MEDIA
	default n
	help
	This option enables playback stream parser

config MEDIA_DSP_SLEEP
	bool
	prompt "dsp sleep Support"
	depends on MEDIA
	default n
	help
	This option enables dsp sleep

config MEDIA_DSP_SLEEP_MODE
	int
	prompt "dsp sleep mode, 0: light sleep, 1: deep sleep"
	depends on MEDIA
	default 1
	help
	This option dsp sleep mode, 0: light sleep, 1: deep sleep

config MEDIA_SUB_DSP_LIB
	bool
	prompt "Sub dsp lib support"
	depends on MEDIA
	default n
	help
	This option enable sub dsp lib support

config MEDIA_NEW_DEBUG_DUMP
	bool
	prompt "new debug dump method support"
	depends on MEDIA
	default n
	help
	This option enable new debug dump method support

config MEDIA_MEM_DONGLE
	bool
	prompt "malloc dongle mem"
	depends on APP_TRANSMITTER
	default n
	help
	This option used to malloc dongle mem

rsource "libal/Kconfig"
```

## framework/ota/Kconfig
```kconfig
# Kconfig - Actions ota

#
# Copyright (c) 2016 Actions Corporation
#
# SPDX-License-Identifier: Apache-2.0
#

menuconfig OTA
	bool
	prompt "ota"
	default n
	help
	This option enables actions ota
```

## framework/usb/xear/Kconfig
```kconfig
# Kconfig - Actions power manager

#
# Copyright (c) 2016 Actions Corporation
#
# SPDX-License-Identifier: Apache-2.0
#

menuconfig XEAR
	bool
	prompt "Xear"
	default y
	help
	This option enables xear
	
config XEAR_LED_CTRL
	bool
	prompt "xear led control"
	depends on XEAR
	default y
	help
	This option enables xear led control.

rsource "lib/Kconfig"

#source "ext/actions/system/xear/lib/Kconfig"
#source "framework/usb/xear/lib/Kconfig"
```

## framework/usb/xear/lib/Kconfig
```kconfig
# Kconfig - Actions power manager

#
# Copyright (c) 2016 Actions Corporation
#
# SPDX-License-Identifier: Apache-2.0
#

config XEAR_AUTHENTICATION
	bool
	prompt "xear authentication"
	depends on XEAR
	default y
	help
	This option enables xear authentication.

config XEAR_HID_PROTOCOL
	bool
	prompt "xear hid protocol"
	depends on XEAR
	default y
	help
	This option enables xear hid protocol.
```

## zephyr/boards/arm/cuckoo_dvb_earphone/Kconfig.board
```kconfig
# STM32F469I-DISCO board configuration

# Copyright (c) 2016 Linaro Limited.
# SPDX-License-Identifier: Apache-2.0

config BOARD_CUCKOO_DVB_EARPHONE
	bool "CUCKOO DVB EARPHONE Development Board"
	depends on SOC_CUCKOO
```
