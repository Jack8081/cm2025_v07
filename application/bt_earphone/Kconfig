## zephyr/boards/arm/cuckoo_dvb_earphone/cuckoo_dvb_earphone_defconfig
```kconfig
# SPDX-License-Identifier: Apache-2.0

# Deprecated types
CONFIG_DEPRECATED_ZEPHYR_INT_TYPES=y

# Reserve Header
CONFIG_ROM_START_OFFSET=0

# Soc
CONFIG_SOC_SERIES_CUCKOO=y
CONFIG_SOC_CUCKOO=y
CONFIG_IRQ_VECTOR_IN_SRAM=n
CONFIG_SOC_EP_MODE=y

# Enable MPU
#CONFIG_ARM_MPU=y

# Enable FPU
CONFIG_FPU=y

# Enable irq lock/unlock irq time stat
CONFIG_DISABLE_IRQ_STAT=n
CONFIG_DISABLE_IRQ_MAX_LATENCY_CYCLES=16000

# Enable sw isr table in ram
CONFIG_DYNAMIC_INTERRUPTS=y

# Enable cacheprofile stat
CONFIG_SOC_SPICACHE_PROFILE=n
CONFIG_SOC_SPICACHE_PROFILE_STAT=n
CONFIG_LOG=n

# Enable irq profiler stat
CONFIG_TRACING_IRQ_PROFILER=n
CONFIG_TRACING_IRQ_PROFILER_MAX_LATENCY=n
CONFIG_TRACING_IRQ_PROFILE_MAX_LATENCY_CYCLES=24000
CONFIG_TRACING_IRQ_PROFILER_IRQLOADING=n

# Clock
#CONFIG_CORTEX_M_SYSTICK=y
CONFIG_ACTS_TIMER=y
CONFIG_ACTS_HRTIMER=y
CONFIG_HOSC_CLK_MHZ=32
CONFIG_SYS_CLOCK_HW_CYCLES_PER_SEC=32000000
CONFIG_SYS_CLOCK_TICKS_PER_SEC=500

# Cfg drv
CONFIG_CFG_DRV=y

# Console
CONFIG_CONSOLE=y
CONFIG_UART_CONSOLE=y
CONFIG_UART_CONSOLE_INIT_PRIORITY=83
CONFIG_EARLY_CONSOLE=y
CONFIG_PRINTK=y
CONFIG_STDOUT_CONSOLE=y
CONFIG_UART_CONSOLE_ON_DEV_NAME="UART_0"
CONFIG_UART_SHELL_ON_DEV_NAME="UART_0"
CONFIG_UART_DC5V_ON_DEV_NAME="UART_1"
CONFIG_SERIAL=y

# Uart
CONFIG_UART_ACTS=y
CONFIG_UART_INTERRUPT_DRIVEN=y
CONFIG_UART_ACTS_PORT_0=y
CONFIG_UART_ACTS_PORT_0_NAME="UART_0"
CONFIG_UART_ACTS_PORT_0_BAUD_RATE=115200
CONFIG_UART_ACTS_PORT_0_PRIORITY=0

# I2C
CONFIG_I2C=y
CONFIG_I2C_ACTS=y
CONFIG_I2C_ASYNC=y

# GPIO
CONFIG_GPIO=y
CONFIG_GPIO_ACTS=y

# DMA
CONFIG_DMA=y
CONFIG_DMA_ACTS=y
CONFIG_PDMA_ACTS=y
CONFIG_DMA_DBG_DUMP=y
CONFIG_DMA_SPINOR_RESEVER_CHAN=5

# SPI
CONFIG_SPI=y
CONFIG_SPI_ACTS=y

#code link
CONFIG_USE_DT_CODE_PARTITION=n
CONFIG_FLASH_LOAD_OFFSET=0x0000
CONFIG_FLASH_LOAD_SIZE=0x100000

#mem
CONFIG_SRAM_BASE_ADDRESS=0x1000400
CONFIG_SRAM_SIZE=120
CONFIG_PSRAM_SIZE=0
CONFIG_PSRAM_BASE_ADDRESS=0x18000000

# FLASH
CONFIG_FLASH=y
CONFIG_FLASH_BASE_ADDRESS=0x10000000
CONFIG_FLASH_SIZE=4096
CONFIG_SPI_FLASH_ACTS=y
CONFIG_SOC_SPI0_USE_CK64M=y

# clock
CONFIG_SOC_CPU_USE_CK64M=n
CONFIG_SOC_CPU_USE_CK128M=y
CONFIG_SOC_DSP_FIX_USE_COREPLL=y

#
# Storage
#
#CONFIG_FLASH_MAP=y
#CONFIG_STREAM_FLASH=y
#CONFIG_STREAM_FLASH_ERASE=y
# end of Storage

#
# shell cmd
#
CONFIG_SHELL_DBG=y
CONFIG_SOC_SPICACHE_PROFILE=y
CONFIG_SHELL_HISTORY=n
CONFIG_CMD_SPINOR=n
CONFIG_CMD_SPINAND=n
CONFIG_DATE_SHELL=n

# end of shell cmd

# IPMSG
CONFIG_IPMSG_ACTS=y
CONFIG_IPMSG_ACTS_BTC=y

# MMC
#CONFIG_MMC=y
#CONFIG_MMC_ACTS=y
#CONFIG_MMC_SDCARD=y

# DISK
CONFIG_DISK_ACCESS=y
CONFIG_DISK_ACCESS_SPINAND=n

# file
CONFIG_FILE_SYSTEM=n
CONFIG_FAT_FILESYSTEM_ELM=n
CONFIG_FILE_SYSTEM_SHELL=n
CONFIG_SD_FS=y
CONFIG_SD_FS_VADDR_START=0x13000000

#pipe
CONFIG_NUM_PIPE_ASYNC_MSGS=0

# heap
CONFIG_HEAP_MEM_POOL_SIZE=256
#CONFIG_HEAP_MEM_POOL_MIN_SIZE=64
CONFIG_MINIMAL_LIBC_MALLOC_ARENA_SIZE=0

#posix
CONFIG_POSIX_CLOCK=n


#log
CONFIG_LOG=y
CONFIG_LOG_MODE_MINIMAL=y
CONFIG_ACTIONS_PRINTK_DMA=y
CONFIG_PRINTK_TIME_FREFIX=y
CONFIG_KERNEL_SHOW_STACK=y
CONFIG_ASSERT=y
CONFIG_ASSERT_VERBOSE=n
CONFIG_ASSERT_NO_COND_INFO=y
CONFIG_ASSERT_NO_FILE_INFO=y
CONFIG_PRINTK_DMA_FULL_LOST=y

#nvram
CONFIG_NVRAM_CONFIG=y
CONFIG_NVRAM_STORAGE_FLASH=y
CONFIG_NVRAM_FACTORY_REGION_SEGMENT_SIZE=0x1000
CONFIG_NVRAM_STORAGE_FACTORY_RW_REGION=y
CONFIG_NVRAM_FACTORY_RW_REGION_SEGMENT_SIZE=0x1000
CONFIG_NVRAM_USER_REGION_SEGMENT_SIZE=0x1000


#audio
CONFIG_AUDIO_ACTS=y
CONFIG_AUDIO_OUT_ACTS=y
CONFIG_AUDIO_OUT_DAC_SUPPORT=y
CONFIG_AUDIO_IN_ACTS=y
CONFIG_AUDIO_IN_ADC_SUPPORT=y
CONFIG_AUDIO_IN=y
CONFIG_AUDIO_OUT=y
CONFIG_AUDIO_ANTIPOP_PROCESS=n
CONFIG_AUDIO_POWERON_OPEN_PA=y
CONFIG_AUDIO_IN_ADGAIN_SUPPORT=y
CONFIG_AUDIO_OUT_I2STX_SUPPORT=n
CONFIG_AUDIO_IN_I2SRX_SUPPORT=n
CONFIG_AUDIO_DRIVER_SHELL=y
CONFIG_AUDIO_DRIVER_STREAM_SHELL=y

#power
CONFIG_POWER_SUPPLY=y
CONFIG_POWER_SUPPLY_ACTS_BATTERY=n
CONFIG_ACTS_BATTERY_SUPPLY_INTERNAL=n
CONFIG_ACTS_BATTERY_SUPPLY_EXTERNAL=n
CONFIG_ACTS_BATTERY_ONLY_BATTERY_SAMPLE=n
CONFIG_ACTS_BATTERY_SUPPLY_CHARGER_BOX=n
CONFIG_ACTS_BATTERY_SUPPLY_EXT_COULOMETER=n
CONFIG_ACTS_BATTERY_SUPPORT_CHARGER_NTC=n
CONFIG_ACTS_BATTERY_SUPPORT_FAST_CHARGER=n
CONFIG_ACTS_BATTERY_POWERON_MIN_VOL_WITHOUT_DC5V=3000
CONFIG_SYS_POWER_MANAGEMENT=y
CONFIG_PM=y
CONFIG_DEVICE_POWER_MANAGEMENT=y
#CONFIG_PM_DIRECT_FORCE_MODE=y
CONFIG_PM_POLICY_APP=y
CONFIG_IDLE_STACK_SIZE=1024

#PMU ADC
CONFIG_ADC=y
CONFIG_ADC_ACTS=y
CONFIG_ADC_ACTS_ALWAYS_ON=y

#input
CONFIG_INPUT_DEV=y
CONFIG_INPUT_DEV_ACTS_ADCKEY=y
CONFIG_INPUT_DEV_ACTS_ONOFF_KEY=y
CONFIG_ONOFF_KEY_POLL_TIMER=y
CONFIG_INPUT_DEV_ACTS_GPIOKEY=y
CONFIG_INPUT_DEV_ACTS_TAP_KEY=n
CONFIG_INPUT_DEV_EAR_INOUT=n
CONFIG_INPUT_DEV_EAR_JSA1227=n

#RTC
CONFIG_RTC_ACTS=n

#mpu
CONFIG_MPU_ACTS=y
CONFIG_MPU_MONITOR_FLASH_AREA_WRITE=y
CONFIG_MPU_MONITOR_CACHECODE_WRITE=n
CONFIG_MPU_MONITOR_RAMFUNC_WRITE=n
CONFIG_MPU_MONITOR_USER_DATA=y
CONFIG_MPU_MONITOR_ROMFUNC_WRITE=y

#MISC
CONFIG_AUDIO_CHAN_SEL=y

#pwm
CONFIG_PWM=y
CONFIG_PWM_ACTS=y
CONFIG_ACT_DYNAMIC_LED=y


#anc
CONFIG_ANC=n

#console
CONFIG_DC5V_UART_CONSOLE=y

#watchdog
CONFIG_WDOG_ACTS=y
#CONFIG_WDT_MODE_RESET=y

#libc
CONFIG_LIBC_STRING_BROM=y
CONFIG_CBPRINTF_COMPLETE_BROM=y

#compensation
CONFIG_COMPENSATION=y
CONFIG_COMPENSATION_ACTS=y
CONFIG_COMPENSATION_DEFAULT_HOSC_CAP=120
```

## zephyr/drivers/adc/Kconfig.acts
```kconfig
# ADC configuration options

# Copyright (c) 2021 Actions Semiconductor Co., Ltd
# SPDX-License-Identifier: Apache-2.0

config ADC_ACTS
	bool "Actions ADC driver"
	default y
	help
	  Support the ADC functions for the Actions chipset.

config PMUADC_NAME
	string "PMU ADC Driver's name"
	depends on ADC_ACTS
	default "PMUDAC_0"

config ADC_ACTS_ALWAYS_ON
	bool "Actions ADC function always on"
	depends on ADC_ACTS
	default y
	help
	  Always enable ADC function in normal stage.
```

## zephyr/drivers/display/Kconfig.acts
```kconfig
# Configuration options for Actions Display

# Copyright (c) 2020 Actions Technology Co., Ltd
# SPDX-License-Identifier: Apache-2.0

orsource "engine/Kconfig"
rsource "controller/Kconfig"
rsource "panel/Kconfig"
```

## zephyr/drivers/display/controller/Kconfig
```kconfig
# Configuration options for Actions Display Controller

# Copyright (c) 2020 Actions Technology Co., Ltd
# SPDX-License-Identifier: Apache-2.0

menuconfig DISPLAY_CONTROLLER
	bool "Display Controller"
	help
	  Enable display controller

if DISPLAY_CONTROLLER

config DISPLAY_LCDC
	bool "Display LCD Controller"
	default y
	help
	  Enable LCD display controller

endif # DISPLAY_CONTROLLER
```

## zephyr/drivers/display/engine/Kconfig
```kconfig
# Configuration options for Actions Display Accelerator

# Copyright (c) 2020 Actions Technology Co., Ltd
# SPDX-License-Identifier: Apache-2.0

menuconfig DISPLAY_ENGINE
	bool "Display Engine"
	help
	  Enable display engine

if DISPLAY_ENGINE

module = DISPLAY_ENGINE
module-str = display_engine
source "subsys/logging/Kconfig.template.log_config"

config DISPLAY_ENGINE_INSTANCE_NUM
	int "Display Engine Instance Number"
	default 3
	help
	  Set display engine maximum instances to support

config DISPLAY_ENGINE_HIHG_PRIO_INSTANCE
	bool "Support Display Engine High Priority Instance"
	help
	  Support display engine high priority instance

config DISPLAY_ENGINE_DRAW_COMMAND_NUM
	int "Display Engine Command Number Per Instance"
	default 10
	help
	  Set display engine maximum instances commands to support

config DISPLAY_ENGINE_POST_COMMAND_NUM
	int "Display Engine Command Number Per Instance"
	default 3
	help
	  Set display engine maximum instances commands to support

config DISPLAY_ENGINE_PROCESS_COMMAND_IN_ISR
	bool "Display Engine Process Next Command in Queue in ISR"
	default y
	help
	  Enable display engine process next command in queue in ISR.

config DISPLAY_ENGINE_COMPOSE_ON_VSYNC
	bool "Display Engine Compose Command Waiting for Display Vsync Signal"
	depends on DISPLAY_ENGINE_PROCESS_COMMAND_IN_ISR
	help
	  Enable display engine compose command waiting for display vsync signal

config DISPLAY_ENGINE_COMMAND_TIMEOUT_MS
	int "Display Engine Command Timeout in Milliseconds"
	default 500
	help
	  Set display engine command timeout in milliseconds

config DISPLAY_ENGINE_DITHER
	bool "Dither"
	help
	  Enable display engine dither.

choice DISPLAY_ENGINE_DITHER_STRENGH
	prompt "Dither Strengh"
	default DISPLAY_ENGINE_DITHER_4X4
	depends on DISPLAY_ENGINE_DITHER
	help
	  Set display engine dither strengh.

	config DISPLAY_ENGINE_DITHER_4X4
		bool "Strengh 4x4"

	config DISPLAY_ENGINE_DITHER_8X8
		bool "Strengh 8x8"
endchoice

endif # DISPLAY_ENGINE
```
