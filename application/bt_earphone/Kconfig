## application/bt_earphone/Kconfig
```kconfig
# Kconfig - ACTIONS primitive options for sdk version 2.0

#
# Copyright (c) 2015 Intel Corporation
#
# Licensed under the Apache License, Version 2.0 (the "License");
# you may not use this file except in compliance with the License.
# You may obtain a copy of the License at
#
#     http://www.apache.org/licenses/LICENSE-2.0
#
# Unless required by applicable law or agreed to in writing, software
# distributed under the License is distributed on an "AS IS" BASIS,
# WITHOUT WARRANTIES OR CONDITIONS OF ANY KIND, either express or implied.
# See the License for the specific language governing permissions and
# limitations under the License.
#

mainmenu "BT Box App"

source "Kconfig.zephyr"

menu "App Configuration"

config APP_PRIORITY
    int
    prompt "App Thread Priority"
    default 10
    help
    This option set app thread priority

config APP_STACKSIZE
    int
    prompt "App Thread Stack Size"
    default 2048
    help
    This option set stack size for app thread

config APP_TRANSMITTER
	bool
	prompt "set firmware to transmitter mode"
	default y
	select MEDIA_MEM_DONGLE
	help
	This option set firmware to transmitter mode

rsource "src/main/Kconfig"

rsource "src/btmusic/Kconfig"

rsource "src/btcall/Kconfig"

rsource "src/ota/Kconfig"

rsource "src/tool/Kconfig"

rsource "src/att/Kconfig"

rsource "src/le_audio/Kconfig"

rsource "src/tr_usound/Kconfig"

rsource "src/usound/Kconfig"

rsource "src/tr_usound/usb_audio_sourcesink/Kconfig"

rsource "src/audio_input/Kconfig"

rsource "src/user_comm/Kconfig"

orsource "src/gma/Kconfig"

orsource "src/tme/Kconfig"

orsource "src/netease/Kconfig"

orsource "src/nativevoice/Kconfig"

orsource "src/tuya/Kconfig"

orsource "src/libsrc/consumer_eq/Kconfig"

orsource "src/tr_linein/Kconfig"

orsource "src/usound_bqb/Kconfig"
endmenu
```

## application/bt_earphone/src/btmusic/Kconfig
```kconfig
# Kconfig - ACTIONS primitive options for sdk version 2.0

#
# Copyright (c) 2015 Intel Corporation
#
# Licensed under the Apache License, Version 2.0 (the "License");
# you may not use this file except in compliance with the License.
# You may obtain a copy of the License at
#
#     http://www.apache.org/licenses/LICENSE-2.0
#
# Unless required by applicable law or agreed to in writing, software
# distributed under the License is distributed on an "AS IS" BASIS,
# WITHOUT WARRANTIES OR CONDITIONS OF ANY KIND, either express or implied.
# See the License for the specific language governing permissions and
# limitations under the License.
#

config BT_MUSIC_APP
	bool
	prompt "Bt Music App Support"
	depends on MEDIA_PLAYER
	default n
	select RINGBUFF_STREAM
	help
	This option enable or disable bt music app

config BT_MUSIC_SWITCH_LANTENCY_SUPPORT
	bool
	prompt "bt music support game mode"
	depends on BT_MUSIC_APP
	default n
	help
		This option support bt music app switch lantency mode.

config BT_MUSIC_LOW_LANTENCY_TIME_MS
    int
    prompt "Bt Music App lantency time in low lantency mode"
    depends on BT_MUSIC_SWITCH_LANTENCY_SUPPORT
    default 15000
    help
    This option set time in low lantency mode

config BT_MUSIC_RES_SR_UP_TO_48
	bool
	prompt "bt music support res 44k to 48k"
	depends on BT_MUSIC_APP
	default n
	help
		This option support bt music res 44k to 48k.
```

## application/bt_earphone/src/le_audio/Kconfig
```kconfig
# Kconfig - ACTIONS primitive options for sdk version 2.0

#
# Copyright (c) 2015 Intel Corporation
#
# Licensed under the Apache License, Version 2.0 (the "License");
# you may not use this file except in compliance with the License.
# You may obtain a copy of the License at
#
#     http://www.apache.org/licenses/LICENSE-2.0
#
# Unless required by applicable law or agreed to in writing, software
# distributed under the License is distributed on an "AS IS" BASIS,
# WITHOUT WARRANTIES OR CONDITIONS OF ANY KIND, either express or implied.
# See the License for the specific language governing permissions and
# limitations under the License.
#

config LE_AUDIO_APP
	bool
	prompt "LE Audio App Support"
	depends on MEDIA_PLAYER
	default n
	select STREAM
	select RINGBUFF_STREAM
	help
	  This option enables the LE Audio app.

config LE_AUDIO_PHONE
	bool
	prompt "Connect LE Audio with phone"
	depends on LE_AUDIO_APP
	default n
	help
		This option for connect le audio with phone.

config LE_AUDIO_BACKGROUD_IN_BTCALL
    bool
    prompt "support le audio backgroud in btcall"
    depends on BT_CALL_APP && BT_LE_AUDIO
    default n
    help
    This option support le audio backgroud in btcall

config LE_AUDIO_DISPLAY_MULTI_FREQ_BAND_DETECT
    bool
    prompt "support le audio download music multi freq band energe detect."
    depends on LE_AUDIO_APP
    default n
    help
    This option support le audio download music multi freq band energe detect.

config LE_AUDIO_DISPLAY_TIME_ENERGE_DETECT
    bool
    prompt "support le audio download music time domain energe detect."
    depends on LE_AUDIO_APP
    default n
    help
    This option support le audio download music time domain energe detect.

config LE_AUDIO_DOUBLE_SOUND_CARD
	bool
	prompt "LE_AUDIO supprot double sound card"
    depends on LE_AUDIO_APP
	default n
	help
	This option enables or disable the le audio support double sound card.
```

## application/bt_earphone/src/tool/Kconfig
```kconfig
# Kconfig - ACTIONS primitive options for sdk version 2.0

#
# Copyright (c) 2015 Intel Corporation
#
# Licensed under the Apache License, Version 2.0 (the "License");
# you may not use this file except in compliance with the License.
# You may obtain a copy of the License at
#
#     http://www.apache.org/licenses/LICENSE-2.0
#
# Unless required by applicable law or agreed to in writing, software
# distributed under the License is distributed on an "AS IS" BASIS,
# WITHOUT WARRANTIES OR CONDITIONS OF ANY KIND, either express or implied.
# See the License for the specific language governing permissions and
# limitations under the License.
#

menuconfig TOOL
	bool "PC Tool Support"
	default y
	help
	This option enables the PC TOOL

config TOOL_STACK_SIZE
	int "PC Tool thread stack size"
	depends on TOOL
	default 2048
	help
	This option configure PC Tool thread stack

config TOOL_ASET
	bool "PC TOOL ASET Support"
	depends on TOOL && MEDIA_SERVICE
	default y
	help
	This option enables the PC TOOL ASET

config TOOL_ASQT
	bool "PC TOOL ASQT Support"
	depends on TOOL && MEDIA_SERVICE
	default n
	select STREAM
	select ZERO_STREAM
	help
	This option enables the PC TOOL ASQT

config TOOL_ECTT
	bool "PC TOOL ECTT Support"
	depends on TOOL && MEDIA_SERVICE
	default n
	help
	This option enables the PC TOOL ECTT

config SPP_TEST_SUPPORT
	bool 
	prompt "sdk test support through SPP"
	depends on TOOL && BT_MANAGER
	select STREAM
    select BT_SPPBLE_STREAM
	default y
	help
	  This option enable spp test.
	  
config TOOL_ASET_USB_SUPPORT
	bool "ASET TOOL Support communicate by USB"
	depends on TOOL_ASET
	default n
	help
	This option enables the ASET tool communicate by USB.	  
```

## application/bt_earphone/src/tr_usound/Kconfig
```kconfig
# Kconfig - ACTIONS primitive options for sdk version 2.0

#
# Copyright (c) 2015 Intel Corporation
#
# Licensed under the Apache License, Version 2.0 (the "License");
# you may not use this file except in compliance with the License.
# You may obtain a copy of the License at
#
#     http://www.apache.org/licenses/LICENSE-2.0
#
# Unless required by applicable law or agreed to in writing, software
# distributed under the License is distributed on an "AS IS" BASIS,
# WITHOUT WARRANTIES OR CONDITIONS OF ANY KIND, either express or implied.
# See the License for the specific language governing permissions and
# limitations under the License.
#

config TR_USOUND_APP
	bool
	prompt "TR_USOUND App Support"
	depends on USB_AUDIO_SOURCESINK && USB_DEVICE_HID
	depends on  MEDIA_PLAYER
	select STREAM
	select RINGBUFF_STREAM
	select USB_APP_AUDIO_DEVICE 
	default n
	help
	This option enables or disable the usb audio app.

config TR_USOUND_SPEAKER
	bool
	prompt "TR_USOUND IN"
	depends on TR_USOUND_APP
	select SUPPORT_USB_AUDIO_SINK 
	default n
	help
	This option enables or disable the usb audio in.

config TR_USOUND_MIC
	bool
	prompt "TR_USOUND OUT"
	depends on TR_USOUND_APP
	select SUPPORT_USB_AUDIO_SOURCE 
	default n
	help
	This option enables or disable the usb audio out.

config TR_USOUND_DOUBLE_SOUND_CARD
	bool
	prompt "TR_USOUND supprot double sound card"
	depends on TR_USOUND_APP
	default n
	help
	This option enables or disable the usb audio support double sound card.

config TR_USOUND_START_STOP_CIS_DETECT
	bool
	prompt "TR_USOUND supprot detect cis start stop"
	depends on TR_USOUND_APP
	default n
	help
	This option enable detect start or stop cis.

config USOUND_DISCONNECT_CIS_WAIT_TIME
	int "usound disconnect cis timeout"
	default 30000
	help
	This option specific usound app disconnect cis audio timeout.
	
config TR_USOUND_LISTENED_VIA_AOUT 
	bool
	prompt "listened via aout"
	depends on TR_USOUND_APP
	default n
	help
	This option enables or disable listened via aout.

config TR_USOUND_AUTO_OPEN_LISTENED_VIA_AOUT 
	bool
	prompt "auto open listened via aout"
	depends on TR_USOUND_LISTENED_VIA_AOUT
	default n
	help
	This option enables or disable auto open listened via aout.

config TR_USOUND_UPLOAD_EFX_EN
	bool
	prompt "audio in app enanble upload music effect"
	depends on VOICE_EFFECT 
	default n
	help
	This option enables or disenables upload music effect

config EXTERNAL_DSP 
	bool
	prompt "support external dsp process"
	depends on TR_USOUND_APP
	default n
	help
	This option support external dsp process.

config SUPPORT_MUTE_SHORTCUT_KEY_PAIR 
	bool
	prompt "support mute/unmute shortcut key"
	depends on TR_USOUND_APP
	default n
	help
	This option support mute/unmute shortcut key.

config SUPPORT_VOL_SYNC_HOST_TO_DEV 
    bool                                                                                 
    prompt "dongle support vol sync host to device"
    depends on TR_USOUND_APP        
    default n                                                                            
    help                                                                                 
    This option support vol sync host to device.

config EXTERNAL_DSP_AUDIO_CHANNEL_MODE
	int
	prompt "USB audio channel mode when external dsp"
	default 0
	help
	  USB audio channel mode when external dsp.

config USB_IOS_IAP2_SUPPORT
	bool
	prompt "Enable USB ios iap2 protocol"
	default n

config USB_DOWNLOAD_LISTEN_SUPPORT
	bool
	prompt "Enable USB download listen support"
	depends on TR_USOUND_LISTENED_VIA_AOUT
	default n

config TR_USOUND_SELECT_SPDIFRX_DOWNLOAD
	bool
	prompt "support gain adjust"
	default n
	help
	This option enables or disable gain adjust.

config DONGLE_SUPPORT_TWS
	bool
	prompt "dongle support tws mode"
	default n
	help
	This option enables or disable dongle tws mode.
```

## application/bt_earphone/src/tr_usound/disk/Kconfig
```kconfig
#
# Copyright (c) 2016 Intel Corporation
#
# SPDX-License-Identifier: Apache-2.0
#

config DISK_ACCESS_USB
	bool "usb disk"
	depends on USB_HOST_STORAGE
	default n
	help
	usb disk is used for the file system.
```

## application/bt_earphone/src/tr_usound/usb_audio_sourcesink/Kconfig
```kconfig
menuconfig USB_APP_AUDIO_DEVICE
	bool
	prompt "enable USB audio device APP"
	default n
	help
	  enable USB audio device APP.

if USB_APP_AUDIO_DEVICE

config USB_APP_AUDIO_DEVICE_MANUFACTURER
	string
	prompt "USB audio(composite device) manufacturer name"
	default "C-Media Electronics Inc."
	help
	  USB audio device manufacturer string. can be configured by vendor.

config USB_APP_AUDIO_DEVICE_PRODUCT
	string
	prompt "USB AUDIO device product name"
	default "Wireless gaming headset"
	help
	  USB audio device product string. can be configured by vendor.

config USB_APP_AUDIO_DEVICE_SN
	string
	prompt "USB audio device serial number"
	default "0123456789AB"
	help
	  USB audio device serial number string. can be configured by vendor.

config USB_APP_AUDIO_DEVICE_GAME
	string
	prompt "USB audio device double soundcard game name"
	default "USB Audio Game Sound"
	help
	  USB audio device double soundcard game string. can be configured by vendor.

config USB_APP_AUDIO_DEVICE_VOICE
	string
	prompt "USB audio device double soundcard voice name"
	default "USB Audio Chat Sound"
	help
	  USB audio device double soundcard voice string. can be configured by vendor.

config USB_APP_AUDIO_DEVICE_STRING50
	string
	prompt "String 50"
	default "CMA192"
	help
	 String 50

config USB_APP_AUDIO_DEVICE_SN_NVRAM
	string
	prompt "get serial number from NVRAM"
	default "BT_MAC"
	help
	  get audio device serial number string from NVRAM, can be configured by vendor.

config USB_APP_AUDIO_DEVICE_VID
	hex
	prompt "USB audio device vendor ID"
	default 0x0d8c
	help
	  USB audio device vendor ID. MUST be configured by vendor.

config USB_APP_AUDIO_DEVICE_PID
	hex
	prompt "USB audio device product ID"
	default 0x0304
	help
	  USB audio device product ID. MUST be configured by vendor.

endif #USB_APP_AUDIO_DEVICE
```
